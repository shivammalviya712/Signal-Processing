#include <math.h>


double x[] = {-105.9947996,-94.28843862,-97.99796782,-90.4268951,-103.2529255,-106.23768,-117.0864828,-104.4554756,-139.3772925,-106.8944671,-139.4080029,-127.0524831,-119.9226746,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 0, 0};
double y[1500];
double y_auto[1500];

void setup() {
  Serial.begin(9600);
  int i = 0;
  int n = 1500;
  
  for (i = 4; i < n+4; i++)
  {
      y[i - 4] = (x[i] + x[i-1] + x[i-2] + x[i-3] + x[i-4])/5;
  }
}

void loop() {

    static int i = 0;
    int j;
    
    for(j = 0; j < 1500 - i; j += 1)
    {
        y_auto[i] += y[j]*y[i+j];   
    }

    if (i < 1500)
    {
        Serial.println(y_auto[i]);
        
    }
    i += 1;

    if ( i == 1500)
        Serial.println(period());
}

int period()
{
    int i = 0;
    for (i = 1; i < 1499; i++)
    {
        if (y_auto[i-1] <= y_auto[i] and y_auto[i+1] <= y_auto[i])
            return i; 
    }
}
